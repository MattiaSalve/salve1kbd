## config/boards/shields/salve1/Kconfig.defconfig
```kconfig
if SHIELD_SALVE1_LEFT

config ZMK_KEYBOARD_NAME
    default "Salve1"

config ZMK_SPLIT_ROLE_CENTRAL
    default y

endif

if SHIELD_SALVE1_LEFT || SHIELD_SALVE1_RIGHT

config ZMK_SPLIT
    default y

endif
```

## config/boards/shields/salve1/Kconfig.shield
```kconfig
config SHIELD_SALVE1_LEFT
    def_bool $(shields_list_contains,salve1_left)

config SHIELD_SALVE1_RIGHT
    def_bool $(shields_list_contains,salve1_right)
```
